## components/app_cfg/Kconfig.projbuild
```kconfig
menu "Application Configuration"

    config APP_RELAY_GPIO
        int "Heating relay GPIO number"
        range 0 48
        default 4
        help
            驱动加热继电器输入的 GPIO 引脚号。

    config APP_RELAY_ACTIVE_HIGH
        bool "Relay is active-high (heating = drive 1)"
        default y
        help
            启用后:加热 = 输出 1,停止 = 输出 0(高电平有效继电器)。

    config APP_I2C_SDA_GPIO
        int "SHT40 I2C SDA GPIO"
        range 0 48
        default 8

    config APP_I2C_SCL_GPIO
        int "SHT40 I2C SCL GPIO"
        range 0 48
        default 9

    config APP_MQTT_URI_DEFAULT
        string "Default MQTT broker URI"
        default "mqtt://192.168.31.242:1883"
        help
            NVS 中没有有效 URI 时使用的默认 MQTT broker 地址。

    config APP_DEVICE_ID_PREFIX
        string "Device ID prefix"
        default "s3-thermostat"
        help
            设备 ID 格式:<前缀>-<STA MAC 后 3 字节>。

    config APP_LED_WS2812_GPIO
        int "WS2812 RGB status LED data GPIO (-1 = LED disabled)"
        range -1 48
        default 48
        help
            板载 WS2812 幻彩 RGB 状态灯的数据引脚(DIN)。
            (规范:ESP32-S3 温控设备 RGB 指示灯状态 V1.0 §5 —
            WS2812 必须使用专用驱动,绝不允许用三个普通 GPIO 模拟。)
            ESP32-S3-DevKitC-1 上为 GPIO48。设为 -1 可完全禁用
            状态灯模块(编译为空实现)。

    config APP_LED_WS2812_BRIGHTNESS
        int "WS2812 LED channel brightness (1-255)"
        range 1 255
        default 64
        help
            点亮通道的亮度级别(0 = 灭)。WS2812 满亮度非常刺眼,
            64(约 25%)清晰可见又不刺眼。规范颜色保持精确开/关,
            仅整体亮度缩放。

    config APP_FAN_PWM_GPIO
        int "4-wire fan PWM control GPIO (-1 = fan disabled)"
        range -1 48
        default 5
        help
            4线 PWM 风扇的调速输入(风扇第4脚,蓝线)的 GPIO。
            输出 25kHz PWM,占空比 0-100%。默认 GPIO5。
            注意:ESP32-S3 GPIO 非 5V 耐受,若风扇 PWM 线内部
            上拉至 5V,须串 1K 电阻或用 NPN/NMOS 开漏驱动。
            设为 -1 可完全禁用风扇调速。禁止占用启动捆绑脚
            (0/3/45/46)与 USB 脚(19/20)。

    config APP_FAN_TACH_GPIO
        int "4-wire fan tachometer input GPIO (-1 = tach disabled)"
        range -1 48
        default 6
        help
            4线 PWM 风扇的转速脉冲输入(风扇第3脚,绿线,开漏输出)
            的 GPIO。需外部 10K 电阻上拉至 3.3V(严禁上拉至 5V)。
            默认 GPIO6。设为 -1 可完全禁用测速(转速恒为 0)。

    config APP_FAN_DEFAULT_DUTY
        int "Fan default PWM duty percent at boot (0-100)"
        range 0 100
        default 0
        help
            上电初始风扇占空比(%),0 = 停转。该值不持久化,
            每次上电取此配置值。

endmenu
```

## sdkconfig.defaults
```kconfig
# 全新配置时应用的项目默认值(sdkconfig 本身被 gitignore)。
# 16MB Flash + 自定义分区表(factory 应用分区更大)。
CONFIG_ESPTOOLPY_FLASHSIZE_16MB=y
CONFIG_PARTITION_TABLE_CUSTOM=y
CONFIG_PARTITION_TABLE_CUSTOM_FILENAME="partitions.csv"

# 状态 RGB 灯:板载 WS2812(可寻址、单数据线)位于 GPIO48
# (ESP32-S3-DevKitC-1)。规范 §5:WS2812 必须使用专用驱动。
CONFIG_APP_LED_WS2812_GPIO=48

# 串口日志级别 INFO:温度探测、MQTT 收发等日志均在此级别输出
CONFIG_LOG_DEFAULT_LEVEL_INFO=y
```
